## package/amlogic/broadcom/Config.in
```kconfig
config BR2_PACKAGE_BROADCOM
	bool "Support for Broadcom WiFi modules"
	default n
	help
	  This option will install FW and NVRAM files to support various
	  Broadcom wifi chips on Amlogic platforms.

	  NOTE: The kernel side driver is required

choice
	prompt "Wifi module"
	depends on BR2_PACKAGE_BROADCOM
	default BR2_PACKAGE_BROADCOM_AP6330_AP6210

config BR2_PACKAGE_BROADCOM_4330
	bool "4330"

config BR2_PACKAGE_BROADCOM_40181
	bool "40181"

config BR2_PACKAGE_BROADCOM_40183
	bool "40183"

config BR2_PACKAGE_BROADCOM_AP62X2
	bool "ap62x2"

config BR2_PACKAGE_BROADCOM_AP6181
	bool "ap6181"

config BR2_PACKAGE_BROADCOM_AP6210
	bool "ap6210"

config BR2_PACKAGE_BROADCOM_AP6330
	bool "ap6330 (ap6210 and ap6330)"

config BR2_PACKAGE_BROADCOM_AP6476
	bool "ap6476"

config BR2_PACKAGE_BROADCOM_AP6493
	bool "ap6493"

endchoice

config BR2_PACKAGE_BROADCOM_MODULE
	string
	default "bcm4330"		if BR2_PACKAGE_BROADCOM_4330
	default "bcm40181" 		if BR2_PACKAGE_BROADCOM_40181
	default "bcm40183"		if BR2_PACKAGE_BROADCOM_40183
	default "ap62x2"		if BR2_PACKAGE_BROADCOM_AP62X2
	default "ap6181"		if BR2_PACKAGE_BROADCOM_AP6181
	default "ap6210"		if BR2_PACKAGE_BROADCOM_AP6210
	default "ap6330"		if BR2_PACKAGE_BROADCOM_AP6330
	default "ap6476"		if BR2_PACKAGE_BROADCOM_AP6476
	default "ap6493"		if BR2_PACKAGE_BROADCOM_AP6493
```

## package/amlogic/dvb_firmware/Config.in
```kconfig
config BR2_PACKAGE_DVB_FIRMWARE
	bool "Download and install USB DVB Firmwares"
	default n
	help
	  This option will download USB DVB firmwares from
	  linuxtv.org and install them in /etc/firmware
```

## package/amlogic/libamplayer/Config.in
```kconfig
config BR2_PACKAGE_LIBAMPLAYER
        depends on BR2_BOARD_TYPE_AMLOGIC_M6 || BR2_BOARD_TYPE_AMLOGIC_M3 || BR2_BOARD_TYPE_AMLOGIC_M1
        bool "libamplayer"
        help
          amlogic media player library for M1/M3/M6

choice
	prompt "build type"
	depends on BR2_PACKAGE_LIBAMPLAYER
	default BR2_PACKAGE_LIBAMPLAYER_PREBUILT

config BR2_PACKAGE_LIBAMPLAYER_PREBUILT
	bool "prebuilt"
	help
	  Use prebuilt libamplayer included in source tree.

config BR2_PACKAGE_LIBAMPLAYER_SOURCE
	bool "source"
	help
	  Use a git or mercurial repo to build libamplayer from source.

endchoice

choice
	prompt "repo type"
	depends on BR2_PACKAGE_LIBAMPLAYER_SOURCE
	default BR2_PACKAGE_LIBAMPLAYER_SOURCE_GIT

config BR2_PACKAGE_LIBAMPLAYER_SOURCE_GIT
	bool "git"

config BR2_PACKAGE_LIBAMPLAYER_SOURCE_HG
	bool "mercurial"

endchoice

config BR2_PACKAGE_LIBAMPLAYER_SOURCE_URL
	string "repo url"
	depends on BR2_PACKAGE_LIBAMPLAYER_SOURCE_GIT || BR2_PACKAGE_LIBAMPLAYER_SOURCE_HG

config BR2_PACKAGE_LIBAMPLAYER_SOURCE_VERSION
	string "repo version"
	depends on BR2_PACKAGE_LIBAMPLAYER_SOURCE_GIT || BR2_PACKAGE_LIBAMPLAYER_SOURCE_HG
```

## package/amlogic/libamplayerm3/Config.in
```kconfig
config BR2_PACKAGE_LIBAMPLAYERM3
        bool "libamplayerm3"
        help
          amlogic media player library for M3.

          http://openlinux.amlogic.com
```

## package/amlogic/libamplayerm6/Config.in
```kconfig
config BR2_PACKAGE_LIBAMPLAYERM6
        depends on BR2_BOARD_TYPE_AMLOGIC_M6
        bool "libamplayerm6"
        help
          amlogic media player library for M6
```

## package/amlogic/opengl/Config.in
```kconfig
config BR2_PACKAGE_OPENGL
	bool "opengl"
	help
	  OpenGL framebuffer userspace drivers for Amlogic platform

choice
	prompt "OpenGL version"
	depends on BR2_PACKAGE_OPENGL && (BR2_BOARD_TYPE_AMLOGIC_M1 || BR2_BOARD_TYPE_AMLOGIC_M3 || BR2_BOARD_TYPE_AMLOGIC_M6)
	default BR2_PACKAGE_OPENGL_API20 if BR2_BOARD_TYPE_AMLOGIC_M6
	default BR2_PACKAGE_OPENGL_API9 if (BR2_BOARD_TYPE_AMLOGIC_M1 || BR2_BOARD_TYPE_AMLOGIC_M3)

config BR2_PACKAGE_OPENGL_API9
    bool "Mali 400 OpenGL API 9"
    depends on !BR2_ARM_EABIHF

config BR2_PACKAGE_OPENGL_API17
    bool "Mali 400 OpenGL API 17"
    depends on BR2_ARM_EABIHF

config BR2_PACKAGE_OPENGL_API19
    bool "Mali 400 OpenGL API 19"
    depends on !BR2_ARM_EABIHF

config BR2_PACKAGE_OPENGL_API20
    bool "Mali 400 OpenGL API 20"
    depends on BR2_ARM_EABIHF

endchoice
```

## package/driver_gpu_mali/Config.in
```kconfig
config BR2_PACKAGE_DRIVER_GPU_MALI
    bool "Mali GPU Driver"
    help
	Mali Userspace GPU Driver

	https://github.com/linux-sunxi/sunxi-mali/
```

## package/libump/Config.in
```kconfig
config BR2_PACKAGE_LIBUMP
    bool "libump"
    select BR2_PACKAGE_XPROTO_DRI2PROTO
    select BR2_PACKAGE_LIBDRM
    select BR2_PACKAGE_XLIB_XFIXES
    help
	mali libump
	https://github.com/mortaromarcello/libump
```

## package/openssh/Config.in
```kconfig
config BR2_PACKAGE_OPENSSH
	bool "openssh"
	depends on BR2_USE_MMU # fork()
	select BR2_PACKAGE_OPENSSL
	select BR2_PACKAGE_ZLIB
	help
	  A free version of the SSH protocol suite of network connectivity
	  tools.  The standard 'ssh', 'sshd', 'scp', and friends.

	  http://www.openssh.com/

config BR2_PACKAGE_OPENSSH_SFTP_ONLY
    bool "openssh-sftp-server-only"
    depends on BR2_PACKAGE_OPENSSH
    help
      Builds only sftp-server from openssh
      (useful for Dropbear, it does not have own)
```

## package/thirdparty/Config.in
```kconfig
menu "XBMC and its Dependencies"
source "package/thirdparty/fribidi/Config.in"
source "package/thirdparty/jasper/Config.in"
source "package/thirdparty/libass/Config.in"
source "package/thirdparty/libcdio/Config.in"
source "package/thirdparty/libenca/Config.in"
source "package/thirdparty/libmodplug/Config.in"
source "package/thirdparty/libnfs/Config.in"
source "package/thirdparty/libbluray/Config.in"
source "package/thirdparty/libplist/Config.in"
source "package/thirdparty/libshairport/Config.in"
source "package/thirdparty/libssh/Config.in"
source "package/thirdparty/lirc/Config.in"
source "package/thirdparty/afpfs-ng/Config.in"
source "package/thirdparty/librtmp/Config.in"
source "package/thirdparty/recovery_reboot/Config.in"
source "package/thirdparty/taglib18/Config.in"
source "package/thirdparty/tinyxml/Config.in"
source "package/thirdparty/v4lutils/Config.in"
source "package/thirdparty/speedtest_cli/Config.in"
source "package/thirdparty/boblight/Config.in"
source "package/thirdparty/xbmc/Config.in"
source "package/thirdparty/xbmcskins/Config.in"
source "package/thirdparty/xbmcaddons/Config.in"
source "package/thirdparty/xbmcpvr/Config.in"
endmenu
```

## package/thirdparty/kodiaddons/Config.in
```kconfig
menu "Kodi addons"
    depends on BR2_PACKAGE_KODI

comment "Kodi services"

source "package/thirdparty/kodiaddons/opensubtitles/Config.in"

source "package/thirdparty/kodiaddons/weather_yahoo/Config.in"

comment "Kodi scripts"

source "package/thirdparty/kodiaddons/nm/Config.in"

endmenu
```

## package/thirdparty/kodiaddons/nm/Config.in
```kconfig
config BR2_PACKAGE_KODI_ADDON_NM
    bool "script.linux.nm"
    help
      Kodi WiFi Manager Addon
```

## package/thirdparty/kodiaddons/opensubtitles/Config.in
```kconfig
config BR2_PACKAGE_KODI_ADDON_OPENSUBTITLES
    bool "service.subtitles.opensubtitles"
    default y
    help
      Kodi Open Subtitles Addon
```

## package/thirdparty/kodiaddons/weather_yahoo/Config.in
```kconfig
config BR2_PACKAGE_KODI_ADDON_WEATHER_YAHOO
    bool "weather.yahoo"
    default y
    help
      Kodi Yahoo Weather Addon
```

## package/thirdparty/speedtest_cli/Config.in
```kconfig
config BR2_PACKAGE_SPEEDTEST_CLI
	bool "speedtest_cli"
	depends on BR2_PACKAGE_PYTHON
	help
	  Command Line Network Speed Test

	  $ speedtest-cli -h
	  usage: speedtest-cli [-h] [--share] [--simple] [--list] [--server SERVER]
	                       [--mini MINI] [--source SOURCE] [--version]

	  Command line interface for testing internet bandwidth using speedtest.net.
	  --------------------------------------------------------------------------
	  https://github.com/sivel/speedtest-cli

	  optional arguments:
	    -h, --help       show this help message and exit
	    --share          Generate and provide a URL to the speedtest.net share
	                     results image
	    --simple         Suppress verbose output, only show basic information
	    --list           Display a list of speedtest.net servers sorted by distance
	    --server SERVER  Specify a server ID to test against
	    --mini MINI      URL of the Speedtest Mini server
	    --source SOURCE  Source IP address to bind to
	    --version        Show the version number and exit
```

## package/thirdparty/xbmc/Config.in
```kconfig
config BR2_PACKAGE_XBMC
	bool "xbmc"
	depends on BR2_PACKAGE_UDEV
	select BR2_PACKAGE_ALSA_UTILS
	select BR2_PACKAGE_ALSA_UTILS_ALSAMIXER
	select BR2_PACKAGE_FLAC
	select BR2_PACKAGE_LIBASS
	select BR2_PACKAGE_LIBMAD
	select BR2_PACKAGE_LIBMPEG2
	select BR2_PACKAGE_LIBOGG
	select BR2_PACKAGE_LIBSAMPLERATE
	select BR2_PACKAGE_LIBTHEORA
	select BR2_PACKAGE_LIBVORBIS
	select BR2_PACKAGE_WAVPACK
	select BR2_PACKAGE_BZIP2
	select BR2_PACKAGE_DBUS
	select BR2_PACKAGE_LIBCDIO
	select BR2_PACKAGE_PYTHON
	select BR2_PACKAGE_PYTHON_BZIP2
	select BR2_PACKAGE_PYTHON_BSDDB
	select BR2_PACKAGE_PYTHON_CURSES
	select BR2_PACKAGE_PYTHON_PYEXPAT
	select BR2_PACKAGE_PYTHON_READLINE
	select BR2_PACKAGE_PYTHON_SSL
	select BR2_PACKAGE_PYTHON_UNICODEDATA
	select BR2_PACKAGE_PYTHON_SQLITE
	select BR2_PACKAGE_PYTHON_ZLIB
	select BR2_PACKAGE_PYTHON_CODECSCJK
	select BR2_PACKAGE_LZO
	select BR2_PACKAGE_ZLIB
	select BR2_PACKAGE_LIBGCRYPT
	select BR2_PACKAGE_OPENSSL
	select BR2_PACKAGE_MYSQL_CLIENT
	select BR2_PACKAGE_SQLITE
	select BR2_PACKAGE_FONTCONFIG
	select BR2_PACKAGE_FREETYPE
	select BR2_PACKAGE_JASPER
	select BR2_PACKAGE_JPEG
	select BR2_PACKAGE_LIBMODPLUG
	select BR2_PACKAGE_LIBPNG
	select BR2_PACKAGE_LIBUNGIF
	select BR2_PACKAGE_TIFF
	select BR2_PACKAGE_LIBCURL
	select BR2_PACKAGE_LIBMICROHTTPD
	select BR2_PACKAGE_LIBSSH2
	select BR2_PACKAGE_BOOST
	select BR2_PACKAGE_BOOST_THREAD
	select BR2_PACKAGE_FRIBIDI
	select BR2_PACKAGE_NCURSES
	select BR2_PACKAGE_NCURSES_TARGET_PANEL
	select BR2_PACKAGE_NCURSES_TARGET_FORM
	select BR2_PACKAGE_NCURSES_TARGET_MENU
	select BR2_PACKAGE_PCRE
	select BR2_PACKAGE_READLINE
	select BR2_PACKAGE_EXPAT
	select BR2_PACKAGE_LIBXML2
	select BR2_PACKAGE_LIBXSLT
	select BR2_PACKAGE_YAJL
	select BR2_PACKAGE_SAMBA
	select BR2_PACKAGE_SAMBA_LIBSMBCLIENT
	select BR2_PACKAGE_LIBNFS
	select BR2_PACKAGE_LIBRTMP
	select BR2_PACKAGE_AFPFS_NG
	select BR2_PACKAGE_LIBBLURAY
	select BR2_PACKAGE_LIBPLIST
	select BR2_PACKAGE_LIBSHAIRPORT
	select BR2_PACKAGE_AVAHI
	select BR2_PACKAGE_AVAHI_DAEMON
	select BR2_PACKAGE_NCURSES_TARGET_PANEL
	select BR2_PACKAGE_NCURSES_TARGET_FORM
	select BR2_PACKAGE_NCURSES_TARGET_MENU
	select BR2_PACKAGE_OPENGL
	select BR2_PACKAGE_LIBUSB
	select BR2_PACKAGE_LIBUSB_COMPAT
        select BR2_PACKAGE_TINYXML
	select BR2_PACKAGE_TAGLIB18
	select BR2_PACKAGE_LIBSSH
	select BR2_PACKAGE_BOBLIGHT
	select BR2_PACKAGE_XBMCPVR
	select BR2_PACKAGE_LIBCEC
	select BR2_PACKAGE_LIBAMPLAYER if BR2_ARM_AMLOGIC
	select BR2_PACKAGE_AMREMOTE_CONFIG if BR2_ARM_AMLOGIC
	select BR2_PACKAGE_XBMC_ADDON_NM
	help
	xbmc

		http://xbmc.org

menu "XBMC Options"
	depends on BR2_PACKAGE_XBMC

comment "XBMC Customization Options"

config BR2_XBMC_REMOTE_CONF
	string "Remote Configuration"
	default ""
	help
	  This option will set the IR remote configuration.

	  NOTES:
		- If this option is not set XBMC will use it's default remote configuration
		- Selected configuration will be installed to "/etc/xbmc/remote.conf"
		- Remote configuration should be located in "package/thirdparty/xbmc/remotes"
		- Compiler will append ".conf" to end of file name

config BR2_XBMC_KEYMAP
	string "Keymap"
	default ""
	help
	  This option will set the keymap to be used.

	  NOTES:
		- If this option is not set XBMC will use it's default keymap
		- Selected keymap will be installed to "/usr/share/xbmc/system/keymaps"
		- Keymap should be located in "package/thirdparty/xbmc/keymaps"
		- Compiler will append ".xml" to end of file name

config BR2_XBMC_ADV_SETTINGS
	string "Advanced settings"
	default ""
	help
	  This option will set the advanced settings to be used.

	  NOTES:
		- If this option is not set XBMC will use it's default advanced settings
		- Selected configuration will be installed to "/usr/share/xbmc/system/advancedsettings.xml"
		- Remote configuration should be located in "package/thirdparty/xbmc/settings"
		- Compiler will append ".xml" to end of file name

config BR2_XBMC_SPLASH
	string "Splash Screen"
	default ""
	help
	  This option changes the boot splash.

	  NOTES: 
		- If this option is not set XBMC will use it's default splash
		- Selected image should be 1280x720 and .PNG format
		- Splash should be located in "package/thirdparty/xbmc/logos"
		- Compiler will append ".png" to end of file name

config BR2_XBMC_STARTING_FB
	string "Starting FB splash"
	default ""
	help
	  This option changes the starting fb splash.

	  NOTES: 
		- If this option is not set XBMC will use it's default starting fb splash
		- Splash should be located in "package/thirdparty/xbmc/fb_splashs"
		- Compiler will append ".fb.lzo" to end of file name

config BR2_XBMC_STOPPING_FB
	string "Stopping FB splash"
	default ""
	help
	  This option changes the stopping fb splash.

	  NOTES: 
		- If this option is not set XBMC will use it's default stopping fb splash
		- Splash should be located in "package/thirdparty/xbmc/fb_splashs"
		- Compiler will append ".fb.lzo" to end of file name

config BR2_XBMC_COMPLETE_FB
	string "Complete FB splash"
	default ""
	help
	  This option changes the complete fb splash.

	  NOTES: 
		- If this option is not set XBMC will use it's default complete fb splash
		- Splash should be located in "package/thirdparty/xbmc/fb_splashs"
		- Compiler will append ".fb.lzo" to end of file name

config BR2_XBMC_DEFAULT_SKIN
	string "Default Skin"
	default ""
	help
	  This option will set the default skin.

	  Current choices:
	  	- none

	  NOTES: 
		- If this option is not set XBMC will use confluence
		- The set skin must exist in the source tree
		- Compiler will append "skin." to begining of skin name

config BR2_XBMC_NO_CONFLUENCE
	bool "Don't install confluence skin"
	depends on !BR2_XBMC_DEFAULT_SKIN=""
	default n
	help
	  This option will remove confluence skin from XBMC.

comment "XBMC Power Options"

config BR2_XBMC_POWERDOWN
	bool "Powerdown"
	default y
	help
	  Enable Powerdown option.

config BR2_XBMC_SUSPEND
	bool "Suspend"
	default n
	help
	  Enable Suspend option.

config BR2_XBMC_HIBERNATE
	bool "Hibernate"
	default n
	help
	  Enable Hibernate option.

config BR2_XBMC_REBOOT
	bool "Reboot"
	default y
	help
	  Enable Reboot option.

choice
	prompt "Confluence GUI power button function"
	default BR2_XBMC_SET_CONFLUENCE_POWER_BUTTON_MENU
	depends on !BR2_XBMC_NO_CONFLUENCE
	help
	  This will set the function of the GUI power button

config BR2_XBMC_SET_CONFLUENCE_POWER_BUTTON_MENU
	bool "Power menu"

config BR2_XBMC_SET_CONFLUENCE_POWER_BUTTON_POWERDOWN
	bool "Powerdown"
	depends on BR2_XBMC_POWERDOWN

config BR2_XBMC_SET_CONFLUENCE_POWER_BUTTON_SUSPEND
	bool "Suspend"
	depends on BR2_XBMC_SUSPEND

config BR2_XBMC_SET_CONFLUENCE_POWER_BUTTON_HIBERNATE
	bool "Hibernate"
	depends on BR2_XBMC_HIBERNATE

config BR2_XBMC_SET_CONFLUENCE_POWER_BUTTON_REBOOT
	bool "Reboot"
	depends on BR2_XBMC_REBOOT

endchoice

endmenu
```
