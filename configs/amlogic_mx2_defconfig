## configs/amlogic_mx2_defconfig
```kconfig
BR2_arm=y
BR2_cortex_a9=y
BR2_ARM_EABIHF=y
BR2_ARM_ENABLE_NEON=y
BR2_ARM_FPU_VFPV3D16=y
BR2_ARM_INSTRUCTIONS_THUMB2=y
BR2_BOARD_TYPE_AMLOGIC_M6=y
BR2_OPTIMIZE_2=y
BR2_TOOLCHAIN_EXTERNAL=y
BR2_TOOLCHAIN_EXTERNAL_LINARO_2013_04=y
BR2_PACKAGE_HOST_GDB=y
BR2_EXT_TOOL_DIRS_EXTRA="/usr/share/zoneinfo"
BR2_TARGET_GENERIC_HOSTNAME="buildroot-mx2"
BR2_TARGET_GENERIC_ISSUE="Welcome to MX2 XBMC/Linux"
BR2_TARGET_GENERIC_PASSWD_DES=y
BR2_ROOTFS_DEVICE_CREATION_DYNAMIC_UDEV=y
BR2_TARGET_GENERIC_ROOT_PASSWD="letmein"
BR2_ROOTFS_OVERLAY="board/amlogic/mx2ref/overlay"
BR2_LINUX_KERNEL=y
BR2_LINUX_KERNEL_CUSTOM_GIT=y
BR2_LINUX_KERNEL_CUSTOM_GIT_REPO_URL="git://github.com/wjb/mx-common.git"
BR2_LINUX_KERNEL_CUSTOM_GIT_VERSION="89fc61c4208924d51f07be7c229aeb6796d112d9"
BR2_LINUX_KERNEL_DEFCONFIG="meson6_g18_mx2"
BR2_PACKAGE_BUSYBOX_CONFIG="board/amlogic/mx2ref/mx2-busybox.config"
BR2_PACKAGE_BUSYBOX_SHOW_OTHERS=y
BR2_PACKAGE_ALSA_UTILS_ALSACONF=y
BR2_PACKAGE_ALSA_UTILS_AMIXER=y
BR2_PACKAGE_ALSA_UTILS_APLAY=y
BR2_PACKAGE_ALSA_UTILS_IECSET=y
BR2_PACKAGE_ALSA_UTILS_SPEAKER_TEST=y
BR2_PACKAGE_MPG123=y
BR2_PACKAGE_LIRC=y
BR2_PACKAGE_XBMC=y
BR2_XBMC_REMOTE_CONF="gbox_remote.conf"
# BR2_PACKAGE_BOBLIGHT_LIBUSB is not set
BR2_PACKAGE_LZOP=y
BR2_PACKAGE_GDB=y
BR2_PACKAGE_GDB_DEBUGGER=y
BR2_PACKAGE_STRACE=y
BR2_PACKAGE_FBSET=y
BR2_PACKAGE_CIFS_UTILS=y
BR2_PACKAGE_MTD=y
# BR2_PACKAGE_MTD_MTD_DEBUG is not set
# BR2_PACKAGE_MTD_MTDINFO is not set
# BR2_PACKAGE_MTD_UBIATTACH is not set
# BR2_PACKAGE_MTD_UBICRC32 is not set
# BR2_PACKAGE_MTD_UBIDETACH is not set
# BR2_PACKAGE_MTD_UBIFORMAT is not set
# BR2_PACKAGE_MTD_UBIMKVOL is not set
# BR2_PACKAGE_MTD_UBINFO is not set
# BR2_PACKAGE_MTD_UBINIZE is not set
# BR2_PACKAGE_MTD_UBIRENAME is not set
# BR2_PACKAGE_MTD_UBIRMVOL is not set
# BR2_PACKAGE_MTD_UBIRSVOL is not set
# BR2_PACKAGE_MTD_UBIUPDATEVOL is not set
BR2_PACKAGE_SQUASHFS=y
BR2_PACKAGE_SQUASHFS_LZMA=y
BR2_PACKAGE_SQUASHFS_LZO=y
BR2_PACKAGE_SQUASHFS_XZ=y
BR2_PACKAGE_I2C_TOOLS=y
BR2_PACKAGE_LSUIO=y
BR2_PACKAGE_UBOOT_TOOLS=y
BR2_PACKAGE_UDEV_ALL_EXTRAS=y
BR2_PACKAGE_USBMOUNT=y
BR2_PACKAGE_USBUTILS=y
BR2_PACKAGE_USBUTILS_ZLIB=y
BR2_PACKAGE_LIBID3TAG=y
BR2_PACKAGE_PIXMAN=y
BR2_PACKAGE_LIBTIRPC=y
# BR2_PACKAGE_AVAHI_AUTOIPD is not set
BR2_PACKAGE_BLUEZ_UTILS=y
BR2_PACKAGE_BLUEZ_UTILS_COMPAT=y
BR2_PACKAGE_BLUEZ_UTILS_USB=y
BR2_PACKAGE_LIBNL=y
BR2_PACKAGE_LIBNL_TOOLS=y
BR2_PACKAGE_DROPBEAR=y
BR2_PACKAGE_DROPBEAR_DISABLE_REVERSEDNS=y
# BR2_PACKAGE_DROPBEAR_SMALL is not set
BR2_PACKAGE_NTP=y
BR2_PACKAGE_NTP_NTPDATE=y
BR2_PACKAGE_WIRELESS_TOOLS=y
BR2_PACKAGE_WIRELESS_TOOLS_LIB=y
BR2_PACKAGE_WPA_SUPPLICANT=y
BR2_PACKAGE_WPA_SUPPLICANT_EAP=y
BR2_PACKAGE_WPA_SUPPLICANT_CLI=y
BR2_PACKAGE_WPA_SUPPLICANT_PASSPHRASE=y
BR2_PACKAGE_WPA_SUPPLICANT_DBUS_NEW=y
BR2_PACKAGE_WPA_SUPPLICANT_DBUS_INTROSPECTION=y
BR2_PACKAGE_WPA_SUPPLICANT_WPS=y
BR2_TARGET_ROOTFS_RECOVERY_AML=y
BR2_TARGET_ROOTFS_RECOVERY_AML_BOARDNAME="mx2ref"
```

## configs/amlogic_mx_2_defconfig
```kconfig
BR2_arm=y
BR2_cortex_a9=y
BR2_ARM_ENABLE_NEON=y
BR2_BOARD_TYPE_AMLOGIC_M6=y
BR2_OPTIMIZE_2=y
BR2_TOOLCHAIN_EXTERNAL=y
BR2_TOOLCHAIN_EXTERNAL_LINARO_2013_02=y
BR2_PACKAGE_HOST_GDB=y
BR2_TARGET_GENERIC_HOSTNAME="atv1200"
BR2_TARGET_GENERIC_ISSUE="Welcome to your own ATV1200 HTB."
BR2_TARGET_GENERIC_PASSWD_DES=y
BR2_ROOTFS_DEVICE_CREATION_DYNAMIC_UDEV=y
BR2_TARGET_GENERIC_ROOT_PASSWD="letmein"
BR2_PACKAGE_BUSYBOX_SHOW_OTHERS=y
BR2_PACKAGE_BUSYBOX_WATCHDOG=y
BR2_PACKAGE_BUSYBOX_WATCHDOG_PERIOD="60"
BR2_PACKAGE_XBMC=y
# BR2_PACKAGE_BOBLIGHT_LIBUSB is not set
BR2_PACKAGE_LIBAMPLAYERM6=y
BR2_PACKAGE_GDB=y
BR2_PACKAGE_GDB_DEBUGGER=y
BR2_PACKAGE_STRACE=y
BR2_PACKAGE_FBSET=y
BR2_PACKAGE_XORG7=y
BR2_PACKAGE_XSERVER_XORG_SERVER=y
BR2_PACKAGE_XSERVER_XORG_SERVER_AIGLX=y
BR2_PACKAGE_XAPP_XDPYINFO=y
BR2_PACKAGE_XAPP_XRANDR=y
BR2_PACKAGE_XAPP_XSET=y
BR2_PACKAGE_XAPP_XVINFO=y
BR2_PACKAGE_CIFS_UTILS=y
BR2_PACKAGE_MTD=y
# BR2_PACKAGE_MTD_MTD_DEBUG is not set
# BR2_PACKAGE_MTD_MTDINFO is not set
# BR2_PACKAGE_MTD_UBIATTACH is not set
# BR2_PACKAGE_MTD_UBICRC32 is not set
# BR2_PACKAGE_MTD_UBIDETACH is not set
# BR2_PACKAGE_MTD_UBIFORMAT is not set
# BR2_PACKAGE_MTD_UBIMKVOL is not set
# BR2_PACKAGE_MTD_UBINFO is not set
# BR2_PACKAGE_MTD_UBINIZE is not set
# BR2_PACKAGE_MTD_UBIRENAME is not set
# BR2_PACKAGE_MTD_UBIRMVOL is not set
# BR2_PACKAGE_MTD_UBIRSVOL is not set
# BR2_PACKAGE_MTD_UBIUPDATEVOL is not set
BR2_PACKAGE_SQUASHFS=y
BR2_PACKAGE_SQUASHFS_LZMA=y
BR2_PACKAGE_SQUASHFS_LZO=y
BR2_PACKAGE_SQUASHFS_XZ=y
BR2_PACKAGE_B43_FIRMWARE=y
BR2_PACKAGE_B43_FIRMWARE_KERNEL_BEFORE_3_2=y
BR2_PACKAGE_I2C_TOOLS=y
BR2_PACKAGE_LSUIO=y
BR2_PACKAGE_UDEV_ALL_EXTRAS=y
BR2_PACKAGE_USBUTILS=y
BR2_PACKAGE_USBUTILS_ZLIB=y
BR2_PACKAGE_LIBTIRPC=y
# BR2_PACKAGE_AVAHI_AUTOIPD is not set
BR2_PACKAGE_BLUEZ_UTILS=y
BR2_PACKAGE_BLUEZ_UTILS_COMPAT=y
BR2_PACKAGE_BLUEZ_UTILS_USB=y
BR2_PACKAGE_DROPBEAR=y
BR2_PACKAGE_DROPBEAR_DISABLE_REVERSEDNS=y
# BR2_PACKAGE_DROPBEAR_SMALL is not set
BR2_PACKAGE_NTP=y
BR2_PACKAGE_NTP_NTPDATE=y
BR2_PACKAGE_WIRELESS_TOOLS=y
BR2_PACKAGE_WIRELESS_TOOLS_LIB=y
BR2_PACKAGE_WPA_SUPPLICANT=y
BR2_PACKAGE_WPA_SUPPLICANT_EAP=y
BR2_PACKAGE_WPA_SUPPLICANT_CLI=y
BR2_PACKAGE_WPA_SUPPLICANT_PASSPHRASE=y
BR2_PACKAGE_WPA_SUPPLICANT_DBUS_NEW=y
BR2_PACKAGE_WPA_SUPPLICANT_DBUS_INTROSPECTION=y
BR2_PACKAGE_WPA_SUPPLICANT_WPS=y
BR2_LINUX_KERNEL=y
BR2_LINUX_KERNEL_CUSTOM_GIT=y
BR2_LINUX_KERNEL_CUSTOM_GIT_REPO_URL="https://github.com/nspierbundel/amlogic-common"
BR2_LINUX_KERNEL_CUSTOM_GIT_VERSION="4c4c19a955f4cf0aa18aa1ea34e5e2cde28fa844"
BR2_LINUX_KERNEL_DEFCONFIG="meson6_refg02_nfs2"
```

## configs/amlogic_mx_defconfig
```kconfig
BR2_arm=y
BR2_cortex_a9=y
BR2_ARM_ENABLE_NEON=y
BR2_OPTIMIZE_2=y
BR2_KERNEL_HEADERS_3_0=y
# BR2_SOFT_FLOAT is not set
BR2_TOOLCHAIN_BUILDROOT_LARGEFILE=y
BR2_TOOLCHAIN_BUILDROOT_LOCALE=y
BR2_TOOLCHAIN_BUILDROOT_CXX=y
BR2_TOOLCHAIN_BUILDROOT_USE_SSP=y
BR2_VFP_FLOAT=y
BR2_TARGET_GENERIC_HOSTNAME="atv1200"
BR2_TARGET_GENERIC_ISSUE="Welcome to your own ATV1200 HTB."
BR2_TARGET_GENERIC_PASSWD_DES=y
BR2_TARGET_GENERIC_ROOT_PASSWD="letmein"
BR2_PACKAGE_ALSA_UTILS=y
BR2_PACKAGE_LIBSSH=y
BR2_PACKAGE_LIBRTMP=y
# BR2_PACKAGE_BOBLIGHT_LIBUSB is not set
BR2_PACKAGE_OPENGL=y
BR2_PACKAGE_CIFS_UTILS=y
BR2_PACKAGE_I2C_TOOLS=y
BR2_PACKAGE_UBOOT_TOOLS=y
BR2_PACKAGE_PYTHON=y
BR2_PACKAGE_PYTHON_BZIP2=y
BR2_PACKAGE_PYTHON_BSDDB=y
BR2_PACKAGE_PYTHON_CODECSCJK=y
BR2_PACKAGE_PYTHON_CURSES=y
BR2_PACKAGE_PYTHON_PYEXPAT=y
BR2_PACKAGE_PYTHON_READLINE=y
BR2_PACKAGE_PYTHON_SSL=y
BR2_PACKAGE_PYTHON_SQLITE=y
BR2_PACKAGE_PYTHON_ZLIB=y
BR2_PACKAGE_LIBMAD=y
BR2_PACKAGE_LIBSAMPLERATE=y
BR2_PACKAGE_LZO=y
BR2_PACKAGE_LIBGCRYPT=y
BR2_PACKAGE_FONTCONFIG=y
BR2_PACKAGE_LIBPNG=y
BR2_PACKAGE_LIBUNGIF=y
BR2_PACKAGE_TIFF=y
BR2_PACKAGE_LIBMPEG2=y
BR2_PACKAGE_LIBTHEORA=y
BR2_PACKAGE_LIBCURL=y
BR2_PACKAGE_LIBMICROHTTPD=y
BR2_PACKAGE_PCRE=y
BR2_PACKAGE_LIBXML2=y
BR2_PACKAGE_AVAHI=y
BR2_PACKAGE_BLUEZ_UTILS=y
BR2_PACKAGE_BLUEZ_UTILS_COMPAT=y
BR2_PACKAGE_BLUEZ_UTILS_USB=y
BR2_PACKAGE_DROPBEAR=y
BR2_PACKAGE_DROPBEAR_DISABLE_REVERSEDNS=y
BR2_PACKAGE_SAMBA=y
BR2_PACKAGE_WIRELESS_TOOLS=y
BR2_PACKAGE_WIRELESS_TOOLS_LIB=y
BR2_PACKAGE_WPA_SUPPLICANT=y
BR2_PACKAGE_WPA_SUPPLICANT_EAP=y
BR2_PACKAGE_WPA_SUPPLICANT_CLI=y
BR2_PACKAGE_WPA_SUPPLICANT_PASSPHRASE=y
BR2_PACKAGE_WPA_SUPPLICANT_DBUS_NEW=y
BR2_PACKAGE_WPA_SUPPLICANT_WPS=y
BR2_LINUX_KERNEL=y
BR2_LINUX_KERNEL_CUSTOM_GIT=y
BR2_LINUX_KERNEL_CUSTOM_GIT_REPO_URL="https://github.com/nspierbundel/amlogic-common"
BR2_LINUX_KERNEL_CUSTOM_GIT_VERSION="7e9a0a41b644e5db82b148f9515bdea1d2dfe392"
BR2_LINUX_KERNEL_DEFCONFIG="meson6_refg02_nfs"
```

## configs/amlogic_mx_short_defconfig
```kconfig
BR2_arm=y
BR2_cortex_a9=y
BR2_ARM_ENABLE_NEON=y
BR2_JLEVEL=2
BR2_OPTIMIZE_2=y
BR2_KERNEL_HEADERS_3_0=y
# BR2_SOFT_FLOAT is not set
BR2_TOOLCHAIN_BUILDROOT_LARGEFILE=y
BR2_TOOLCHAIN_BUILDROOT_INET_IPV6=y
BR2_TOOLCHAIN_BUILDROOT_LOCALE=y
BR2_TOOLCHAIN_BUILDROOT_CXX=y
BR2_TOOLCHAIN_BUILDROOT_USE_SSP=y
BR2_ROOTFS_DEVICE_CREATION_DYNAMIC_UDEV=y
BR2_ROOTFS_SKELETON_CUSTOM=y
BR2_ROOTFS_SKELETON_CUSTOM_PATH="board/amlogic/atv1200/skeleton"
BR2_PACKAGE_BUSYBOX_SHOW_OTHERS=y
BR2_PACKAGE_XBMC=y
BR2_PACKAGE_DBUS_GLIB=y
BR2_PACKAGE_I2C_TOOLS=y
BR2_PACKAGE_UBOOT_TOOLS=y
BR2_PACKAGE_UBOOT_TOOLS_MKIMAGE=y
BR2_PACKAGE_BLUEZ_UTILS=y
BR2_PACKAGE_BLUEZ_UTILS_COMPAT=y
BR2_PACKAGE_BLUEZ_UTILS_USB=y
BR2_PACKAGE_DROPBEAR=y
BR2_PACKAGE_DROPBEAR_DISABLE_REVERSEDNS=y
BR2_PACKAGE_SAMBA=y
BR2_PACKAGE_WIRELESS_TOOLS=y
BR2_PACKAGE_WIRELESS_TOOLS_LIB=y
BR2_PACKAGE_WPA_SUPPLICANT=y
BR2_PACKAGE_WPA_SUPPLICANT_EAP=y
BR2_PACKAGE_WPA_SUPPLICANT_CLI=y
BR2_PACKAGE_WPA_SUPPLICANT_PASSPHRASE=y
BR2_PACKAGE_WPA_SUPPLICANT_DBUS_NEW=y
BR2_PACKAGE_WPA_SUPPLICANT_WPS=y
# BR2_TARGET_ROOTFS_TAR is not set
BR2_TARGET_ROOTFS_RECOVERY_AML=y
BR2_TARGET_ROOTFS_RECOVERY_AML_BOARDNAME="stvmx"
BR2_TARGET_ROOTFS_RECOVERY_AML_WIPE_USERDATA_NEVER=y
BR2_LINUX_KERNEL=y
BR2_LINUX_KERNEL_CUSTOM_GIT=y
BR2_LINUX_KERNEL_CUSTOM_GIT_REPO_URL="https://github.com/nspierbundel/amlogic-common"
BR2_LINUX_KERNEL_CUSTOM_GIT_VERSION="1e97baf59cb45c0b78c0f035f095b0eaeca76708"
BR2_LINUX_KERNEL_DEFCONFIG="meson6_refg02"
```

## configs/mx_linux_atv106_defconfig
```kconfig
BR2_arm=y
BR2_cortex_a9=y
BR2_ARM_EABIHF=y
BR2_ARM_ENABLE_NEON=y
BR2_ARM_FPU_VFPV3D16=y
BR2_ARM_INSTRUCTIONS_THUMB2=y
BR2_ARM_AMLOGIC=y
BR2_BOARD_TYPE_AMLOGIC_M6=y
BR2_DEPRECATED=y
BR2_OPTIMIZE_2=y
BR2_TOOLCHAIN_EXTERNAL=y
BR2_TOOLCHAIN_EXTERNAL_LINARO_2013_04=y
BR2_TOOLCHAIN_EXTERNAL_LINARO_GCONV=y
BR2_PACKAGE_HOST_GDB=y
BR2_EXT_TOOL_DIRS_EXTRA="/usr/share/zoneinfo"
BR2_TARGET_GENERIC_HOSTNAME="MX"
BR2_TARGET_GENERIC_ISSUE="Welcome to MX Linux"
BR2_TARGET_GENERIC_PASSWD_DES=y
BR2_TARGET_OPTIMIZATION="-pipe"
BR2_ROOTFS_DEVICE_CREATION_DYNAMIC_UDEV=y
BR2_TARGET_GENERIC_ROOT_PASSWD="letmein"
BR2_ROOTFS_OVERLAY="board/amlogic/M6_MX/overlay"
BR2_LINUX_KERNEL=y
BR2_LINUX_KERNEL_CUSTOM_GIT=y
BR2_LINUX_KERNEL_CUSTOM_GIT_REPO_URL="https://github.com/Stane1983/buildroot-linux-kernel-m6.git"
BR2_LINUX_KERNEL_CUSTOM_GIT_VERSION="2a7cc476da232962a770e6b972a0ffa3b31f04d5"
BR2_LINUX_KERNEL_DEFCONFIG="meson6_g18_atv106"
BR2_PACKAGE_BUSYBOX_CONFIG="board/amlogic/M6_MX/busybox.config"
BR2_PACKAGE_BUSYBOX_SHOW_OTHERS=y
BR2_PACKAGE_ALSA_UTILS_ALSACONF=y
BR2_PACKAGE_ALSA_UTILS_AMIXER=y
BR2_PACKAGE_ALSA_UTILS_APLAY=y
BR2_PACKAGE_ALSA_UTILS_IECSET=y
BR2_PACKAGE_ALSA_UTILS_SPEAKER_TEST=y
BR2_PACKAGE_MPG123=y
# BR2_PACKAGE_LIRC is not set
BR2_PACKAGE_SPEEDTEST_CLI=y
BR2_PACKAGE_XBMC=y
BR2_XBMC_REMOTE_CONF="atv106_remote"
BR2_XBMC_KEYMAP="variant.stvmx.keyboard"
BR2_XBMC_ADV_SETTINGS="stvmx_advancedsettings"
BR2_XBMC_SET_CONFLUENCE_POWER_BUTTON_POWERDOWN=y
BR2_PACKAGE_OPENGL_API20=y
# BR2_PACKAGE_BOBLIGHT_LIBUSB is not set
BR2_PACKAGE_LZOP=y
BR2_PACKAGE_GDB=y
BR2_PACKAGE_GDB_DEBUGGER=y
BR2_PACKAGE_STRACE=y
BR2_PACKAGE_FBDUMP=y
BR2_PACKAGE_FBGRAB=y
BR2_PACKAGE_FBSET=y
BR2_PACKAGE_CIFS_UTILS=y
BR2_PACKAGE_E2FSPROGS=y
BR2_PACKAGE_E2FSPROGS_BADBLOCKS=y
BR2_PACKAGE_E2FSPROGS_CHATTR=y
BR2_PACKAGE_E2FSPROGS_DUMPE2FS=y
BR2_PACKAGE_E2FSPROGS_E2FREEFRAG=y
BR2_PACKAGE_E2FSPROGS_E2FSCK=y
BR2_PACKAGE_E2FSPROGS_E2LABEL=y
BR2_PACKAGE_E2FSPROGS_E2UNDO=y
BR2_PACKAGE_E2FSPROGS_FILEFRAG=y
BR2_PACKAGE_E2FSPROGS_FINDFS=y
BR2_PACKAGE_E2FSPROGS_FSCK=y
BR2_PACKAGE_E2FSPROGS_LOGSAVE=y
BR2_PACKAGE_E2FSPROGS_LSATTR=y
BR2_PACKAGE_E2FSPROGS_MKE2FS=y
BR2_PACKAGE_E2FSPROGS_MKLOSTFOUND=y
BR2_PACKAGE_E2FSPROGS_TUNE2FS=y
BR2_PACKAGE_E2FSPROGS_UUIDGEN=y
BR2_PACKAGE_MTD=y
# BR2_PACKAGE_MTD_MTD_DEBUG is not set
# BR2_PACKAGE_MTD_MTDINFO is not set
# BR2_PACKAGE_MTD_UBIATTACH is not set
# BR2_PACKAGE_MTD_UBICRC32 is not set
# BR2_PACKAGE_MTD_UBIDETACH is not set
# BR2_PACKAGE_MTD_UBIFORMAT is not set
# BR2_PACKAGE_MTD_UBIMKVOL is not set
# BR2_PACKAGE_MTD_UBINFO is not set
# BR2_PACKAGE_MTD_UBINIZE is not set
# BR2_PACKAGE_MTD_UBIRENAME is not set
# BR2_PACKAGE_MTD_UBIRMVOL is not set
# BR2_PACKAGE_MTD_UBIRSVOL is not set
# BR2_PACKAGE_MTD_UBIUPDATEVOL is not set
BR2_PACKAGE_SQUASHFS=y
BR2_PACKAGE_SQUASHFS_LZMA=y
BR2_PACKAGE_SQUASHFS_LZO=y
BR2_PACKAGE_SQUASHFS_XZ=y
BR2_PACKAGE_I2C_TOOLS=y
BR2_PACKAGE_LSUIO=y
BR2_PACKAGE_UBOOT_TOOLS=y
BR2_PACKAGE_UDEV_ALL_EXTRAS=y
BR2_PACKAGE_NTFS_3G=y
BR2_PACKAGE_USBMOUNT=y
BR2_PACKAGE_UTIL_LINUX_BINARIES=y
BR2_PACKAGE_UTIL_LINUX_MOUNT=y
BR2_PACKAGE_USBUTILS=y
BR2_PACKAGE_USBUTILS_ZLIB=y
BR2_PACKAGE_LIBID3TAG=y
BR2_PACKAGE_PIXMAN=y
BR2_PACKAGE_LIBTIRPC=y
# BR2_PACKAGE_AVAHI_AUTOIPD is not set
BR2_PACKAGE_BLUEZ_UTILS=y
BR2_PACKAGE_BLUEZ_UTILS_COMPAT=y
BR2_PACKAGE_BLUEZ_UTILS_USB=y
BR2_PACKAGE_TZDATA=y
BR2_PACKAGE_JPEG_TURBO=y
BR2_PACKAGE_DROPBEAR=y
BR2_PACKAGE_DROPBEAR_DISABLE_REVERSEDNS=y
# BR2_PACKAGE_DROPBEAR_SMALL is not set
BR2_PACKAGE_IFPLUGD=y
BR2_PACKAGE_NTP=y
BR2_PACKAGE_NTP_NTPDATE=y
BR2_PACKAGE_PROFTPD=y
BR2_PACKAGE_TCPDUMP=y
BR2_PACKAGE_TCPDUMP_SMB=y
BR2_PACKAGE_DBUS_PYTHON=y
BR2_PACKAGE_NETWORK_MANAGER=y
BR2_PACKAGE_DHCP=y
BR2_PACKAGE_DHCP_CLIENT=y
BR2_PACKAGE_WIRELESS_TOOLS=y
BR2_PACKAGE_WIRELESS_TOOLS_LIB=y
BR2_PACKAGE_WPA_SUPPLICANT=y
BR2_PACKAGE_WPA_SUPPLICANT_EAP=y
BR2_PACKAGE_WPA_SUPPLICANT_CLI=y
BR2_PACKAGE_WPA_SUPPLICANT_PASSPHRASE=y
BR2_PACKAGE_WPA_SUPPLICANT_DBUS_NEW=y
BR2_PACKAGE_WPA_SUPPLICANT_DBUS_INTROSPECTION=y
BR2_PACKAGE_WPA_SUPPLICANT_WPS=y
BR2_PACKAGE_NANO=y
# BR2_PACKAGE_NANO_TINY is not set
# BR2_TARGET_ROOTFS_TAR is not set
BR2_TARGET_ROOTFS_RECOVERY_AML=y
BR2_TARGET_ROOTFS_RECOVERY_AML_BOARDNAME="g18ref"
BR2_TARGET_ROOTFS_RECOVERY_AML_UPDATE_ZIP_NAME_CUSTOM=y
BR2_TARGET_ROOTFS_RECOVERY_AML_UPDATE_ZIP_NAME_CUSTOM_STRING="MX_LINUX-ATV106"
```

## fs/recovery_aml/Config.in
```kconfig
config BR2_TARGET_ROOTFS_RECOVERY_AML
	bool "AMLogic Recovery Image"
	select BR2_TARGET_ROOTFS_TAR_AML
	select BR2_PACKAGE_RECOVERY_REBOOT
	help
	  Image ready for flashing via android's recovery partition

config BR2_TARGET_ROOTFS_RECOVERY_AML_BOARDNAME
	string "default_name"
	depends on BR2_TARGET_ROOTFS_RECOVERY_AML
	help
	  Name of the Android board(s) (ro.product.board)
	  This option can contain multiple board names separated by space

choice
	prompt "Update package file name"
	default BR2_TARGET_ROOTFS_RECOVERY_AML_UPDATE_ZIP_NAME_FULL_DATETIME
	depends on BR2_TARGET_ROOTFS_RECOVERY_AML
	help
	  Choose how update package will be named

config BR2_TARGET_ROOTFS_RECOVERY_AML_UPDATE_ZIP_NAME_FULL_DATETIME
	bool "Boardname-DDMMMYYYY-hhmmss-update.zip"
      
config BR2_TARGET_ROOTFS_RECOVERY_AML_UPDATE_ZIP_NAME_SHORT_DATE
	bool "Boardname-YYMMDD-update.zip

config BR2_TARGET_ROOTFS_RECOVERY_AML_UPDATE_ZIP_NAME_BOARDNAME_UPDATE_ZIP
	bool "Boardname-update.zip"
      
config BR2_TARGET_ROOTFS_RECOVERY_AML_UPDATE_ZIP_NAME_UPDATE_ZIP
	bool "update.zip"

config BR2_TARGET_ROOTFS_RECOVERY_AML_UPDATE_ZIP_NAME_CUSTOM
	bool "custom-update.zip"

endchoice

config BR2_TARGET_ROOTFS_RECOVERY_AML_UPDATE_ZIP_NAME_CUSTOM_STRING
	string "custom-update.zip"
	depends on BR2_TARGET_ROOTFS_RECOVERY_AML_UPDATE_ZIP_NAME_CUSTOM

choice
	prompt "Erase Userdata"
	default BR2_TARGET_ROOTFS_RECOVERY_AML_WIPE_USERDATA_CONDITIONAL
	depends on BR2_TARGET_ROOTFS_RECOVERY_AML
	help
	  Whether to wipe the userdata partition

config BR2_TARGET_ROOTFS_RECOVERY_AML_WIPE_USERDATA_CONDITIONAL
	bool "yes if previous install was not linux"

config BR2_TARGET_ROOTFS_RECOVERY_AML_WIPE_USERDATA
	bool "yes"

config BR2_TARGET_ROOTFS_RECOVERY_AML_WIPE_USERDATA_NEVER
	bool "no"

endchoice

source "fs/recovery_aml/Config-logo.in"

source "fs/recovery_aml/Config-advanced.in"
```

## package/amlogic/Config.in
```kconfig
menu "AMLogic libraries and programs"
source "package/amlogic/opengl/Config.in"
source "package/amlogic/libamplayerm3/Config.in"
source "package/amlogic/amremote_config/Config.in"
endmenu
```
