## package/thirdparty/xbmcaddons/Config.in
```kconfig
menu "XBMC addons"
    depends on BR2_PACKAGE_KODI

comment "XBMC services"

source "package/thirdparty/xbmcaddons/opensubtitles/Config.in"

source "package/thirdparty/xbmcaddons/weather_yahoo/Config.in"

comment "XBMC scripts"

source "package/thirdparty/xbmcaddons/nm/Config.in"

endmenu
```

## package/thirdparty/xbmcaddons/nm/Config.in
```kconfig
config BR2_PACKAGE_XBMC_ADDON_NM
    bool "nm"
    help
      Xbmc NetworkManager Addon
```

## package/thirdparty/xbmcaddons/opensubtitles/Config.in
```kconfig
config BR2_PACKAGE_XBMC_ADDON_OPENSUBTITLES
    bool "service.subtitles.opensubtitles"
    default y
    help
      Xbmc Open Subtitles Addon
```

## package/thirdparty/xbmcaddons/weather_underground/Config.in
```kconfig
config BR2_PACKAGE_XBMC_ADDON_WEATHER_UNDERGROUND
    bool "weather.wunderground"
    default y
    help
      Xbmc Weather Underground Addon
```

## package/thirdparty/xbmcaddons/weather_yahoo/Config.in
```kconfig
config BR2_PACKAGE_XBMC_ADDON_WEATHER_YAHOO
    bool "weather.yahoo"
    default y
    help
      Xbmc Yahoo Weather Addon
```

## package/thirdparty/xbmcffmpeg/Config.in
```kconfig
comment "xbmcffmpeg needs a toolchain w/ largefile, IPv6"
	depends on !(BR2_LARGEFILE && BR2_INET_IPV6)

config BR2_PACKAGE_XBMCFFMPEG
	bool "xbmcffmpeg"
	depends on BR2_LARGEFILE
	depends on BR2_INET_IPV6
	depends on BR2_PACKAGE_KODI
	help
	  FFmpeg is a complete, cross-platform solution to record, convert
	  and stream audio and video.

	  http://www.ffmpeg.org
```

## package/xdriver_xf86-video-mali/Config.in
```kconfig
config BR2_PACKAGE_XDRIVER_XF86_VIDEO_MALI
    bool "xf86-video-mali"
    select BR2_PACKAGE_DRIVER_GPU_MALI
    select BR2_PACKAGE_LIBUMP
    select BR2_PACKAGE_XORG7
    select BR2_PACKAGE_XSERVER_XORG_SERVER_MODULAR
    select BR2_PACKAGE_XLIB_LIBX11
    select BR2_PACKAGE_XLIB_LIBXRANDR
    select BR2_PACKAGE_XLIB_LIBXRENDER
    select BR2_PACKAGE_XPROTO_RANDRPROTO
    select BR2_PACKAGE_XPROTO_RENDERPROTO
    select BR2_PACKAGE_XPROTO_VIDEOPROTO
    help
      xf86 video mali lib
      https://github.com/mortaromarcello/xf86-video-mali
```
